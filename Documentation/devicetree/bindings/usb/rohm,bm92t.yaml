## Documentation/devicetree/bindings/usb/rohm,bm92t.yaml
```yaml
# SPDX-License-Identifier: (GPL-2.0 OR BSD-2-Clause)
%YAML 1.2
---
$id: http://devicetree.org/schemas/usb/rohm,bm92t.yaml#
$schema: http://devicetree.org/meta-schemas/core.yaml#

title: Rohm Semiconductor BM92TXX USB Type-C / Power Delivery controller

maintainers:
  - Alexandre Hamamdjian <azkali.limited@gmail.com>

description: |
  The Rohm BM92T36 and pin/protocol-compatible siblings integrate a USB
  Type-C CC detection front-end and a Power Delivery PHY together with an
  on-chip MCU that runs the PD state machine autonomously.  The host
  configures the controller and observes attach/detach, contract and VDM
  events over I2C and a level-triggered ALERT line.

  The driver exposes a Type-C port that follows the framework conventions
  in Documentation/devicetree/bindings/connector/usb-connector.yaml, an
  optional USB role switch endpoint, and (when wired) regulator and GPIO
  supplies for VBUS, VBUS-source and the external VCONN switch.

properties:
  compatible:
    enum:
      - rohm,bm92t36
      - rohm,bm92t40

  reg:
    maxItems: 1

  interrupts:
    description: ALERT line.  The controller pulls the line low while
      events are pending; configure as IRQ_TYPE_LEVEL_LOW.
    maxItems: 1

  vbus-supply:
    description: VBUS sink regulator gated when the controller is in sink
      mode.  Optional.

  vbus-source-supply:
    description: VBUS source (provider) regulator enabled when the
      controller acts as a power source.  Optional.

  pd-bat-chg-supply:
    description: Battery charger regulator whose input current limit is
      programmed from the negotiated PD contract.  Optional.

  rohm,vconn-en-gpios:
    description: Active-high enable for an external VCONN switch, when
      the board uses a discrete part for VCONN.
    maxItems: 1

  rohm,pd-5v-input-current-limit-microamp:
    description: Host-side input current cap applied while the PD
      contract is at the 5 V rail.  A missing or zero value lets the
      driver use the source's advertised current.

  rohm,pd-9v-input-current-limit-microamp:
    description: Host-side input current cap applied while the PD
      contract is at the 9 V rail.

  rohm,pd-12v-input-current-limit-microamp:
    description: Host-side input current cap applied while the PD
      contract is at the 12 V rail.

  rohm,pd-15v-input-current-limit-microamp:
    description: Host-side input current cap applied while the PD
      contract is at the 15 V rail.

  connector:
    $ref: /schemas/connector/usb-connector.yaml#
    description: USB Type-C connector node describing the partner-facing
      connector and (optionally) the USB role switch endpoint.

required:
  - compatible
  - reg
  - interrupts

additionalProperties: false

examples:
  - |
    #include <dt-bindings/interrupt-controller/irq.h>
    #include <dt-bindings/gpio/gpio.h>

    i2c {
        #address-cells = <1>;
        #size-cells = <0>;

        typec@18 {
            compatible = "rohm,bm92t36";
            reg = <0x18>;
            interrupt-parent = <&gpio>;
            interrupts = <0 IRQ_TYPE_LEVEL_LOW>;

            vbus-supply = <&vbus_reg>;
            pd-bat-chg-supply = <&bat_chg_reg>;
            rohm,vconn-en-gpios = <&gpio 1 GPIO_ACTIVE_HIGH>;

            rohm,pd-5v-input-current-limit-microamp = <2000000>;
            rohm,pd-9v-input-current-limit-microamp = <2000000>;
            rohm,pd-12v-input-current-limit-microamp = <1500000>;
            rohm,pd-15v-input-current-limit-microamp = <1200000>;

            connector {
                compatible = "usb-c-connector";
                label = "USB-C";
                data-role = "dual";
                power-role = "dual";
                try-power-role = "sink";

                ports {
                    #address-cells = <1>;
                    #size-cells = <0>;
                    port@0 {
                        reg = <0>;
                        endpoint {
                            remote-endpoint = <&usb_role_switch>;
                        };
                    };
                };
            };
        };
    };
```

## drivers/usb/typec/altmodes/Kconfig
```kconfig
# SPDX-License-Identifier: GPL-2.0

menu "USB Type-C Alternate Mode drivers"

config TYPEC_DP_ALTMODE
	tristate "DisplayPort Alternate Mode driver"
	depends on DRM
	help
	  DisplayPort USB Type-C Alternate Mode allows DisplayPort
	  displays and adapters to be attached to the USB Type-C
	  connectors on the system.

	  To compile this driver as a module, choose M here: the
	  module will be called typec_displayport.

config TYPEC_NVIDIA_ALTMODE
	tristate "NVIDIA Alternate Mode driver"
	depends on TYPEC_DP_ALTMODE
	help
	  Latest NVIDIA GPUs support VirtualLink devices. Select this
	  to enable support for VirtualLink devices with NVIDIA GPUs.

	  To compile this driver as a module, choose M here: the
	  module will be called typec_nvidia.

config TYPEC_TBT_ALTMODE
	tristate "Thunderbolt3 Alternate Mode driver"
	help
	  Select this option if you have Thunderbolt3 hardware on your
	  system.

	  To compile this driver as a module, choose M here: the
	  module will be called typec_thunderbolt.

config TYPEC_NINTENDO_ALTMODE
	tristate "Nintendo Switch Dock Alternate Mode driver"
	help
	  Select this option to enable the alternate mode entry sequence
	  and dock-specific vendor commands (front LED, USB hub control,
	  DP-signal disable) used by the official Nintendo Switch Dock
	  on the SVID 0x057E Nintendo alternate mode.

	  To compile this driver as a module, choose M here: the
	  module will be called typec_nintendo.

endmenu
```
