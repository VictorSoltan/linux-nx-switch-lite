// SPDX-License-Identifier: GPL-2.0
/dts-v1/;

#include "tegra210b01-nx.dtsi"

/ {

	model = "Nintendo Switch (2019)";
	compatible = "nvidia,modin", "nvidia,odin", "nintendo,iowa", "nintendo,nx", "nvidia,tegra210b01";
};
